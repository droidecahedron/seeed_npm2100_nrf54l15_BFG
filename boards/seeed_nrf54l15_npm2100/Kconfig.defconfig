## boards/seeed_nrf54l15_npm2100/Kconfig.defconfig
```kconfig
# Copyright (c) 2024 Nordic Semiconductor ASA
# SPDX-License-Identifier: Apache-2.0

config HW_STACK_PROTECTION
	default ARCH_HAS_STACK_PROTECTION

if BOARD_SEEED_NRF54L15_NPM2100_NRF54L15_CPUAPP

config ROM_START_OFFSET
	default 0 if PARTITION_MANAGER_ENABLED
	default 0x800 if BOOTLOADER_MCUBOOT

endif # BOARD_SEEED_NRF54L15_NPM2100_NRF54L15_CPUAPP

if BOARD_SEEED_NRF54L15_NPM2100_NRF54L15_CPUAPP_NS

config BOARD_SEEED_NRF54L15_NPM2100
	select USE_DT_CODE_PARTITION if BOARD_SEEED_NRF54L15_NPM2100_NRF54L15_CPUAPP_NS

# config BT_CTLR
# 	default BT

# By default, if we build for a Non-Secure version of the board,
# enable building with TF-M as the Secure Execution Environment.
config BUILD_WITH_TFM
	default y

endif # BOARD_SEEED_NRF54L15_NPM2100_NRF54L15_CPUAPP_NS
```

## boards/seeed_nrf54l15_npm2100/Kconfig.seeed_nrf54l15_npm2100
```kconfig
# Copyright (c) 2024 Nordic Semiconductor ASA
# SPDX-License-Identifier: Apache-2.0

config BOARD_SEEED_NRF54L15_NPM2100
	select SOC_NRF54L15_CPUAPP if BOARD_SEEED_NRF54L15_NPM2100_NRF54L15_CPUAPP || BOARD_SEEED_NRF54L15_NPM2100_NRF54L15_CPUAPP_NS
	select SOC_NRF54L15_CPUFLPR if BOARD_SEEED_NRF54L15_NPM2100_NRF54L15_CPUFLPR || BOARD_SEEED_NRF54L15_NPM2100_NRF54L15_CPUFLPR_XIP
```

## boards/seeed_nrf54l15_npm2100/board.yml
```yaml
board:
  name: seeed_nrf54l15_npm2100
  full_name: Seeed nRF54L15 & nPM2100 Reference Design
  vendor: nordic
  socs:
    - name: nrf54l15
      variants:
        - name: xip
          cpucluster: cpuflpr
        - name: ns
          cpucluster: cpuapp
runners:
  run_once:
    '--recover':
      - runners:
          - nrfjprog
          - nrfutil
        run: first
        groups:
          - boards:
              - seeed_nrf54l15_npm2100/nrf54l15/cpuapp
              - seeed_nrf54l15_npm2100/nrf54l15/cpuapp/ns
              - seeed_nrf54l15_npm2100/nrf54l15/cpuflpr
              - seeed_nrf54l15_npm2100/nrf54l15/cpuflpr/xip
    '--erase':
      - runners:
          - nrfjprog
          - jlink
          - nrfutil
        run: first
        groups:
          - boards:
              - seeed_nrf54l15_npm2100/nrf54l15/cpuapp
              - seeed_nrf54l15_npm2100/nrf54l15/cpuapp/ns
              - seeed_nrf54l15_npm2100/nrf54l15/cpuflpr
              - seeed_nrf54l15_npm2100/nrf54l15/cpuflpr/xip
    '--reset':
      - runners:
          - nrfjprog
          - jlink
          - nrfutil
        run: last
        groups:
          - boards:
              - seeed_nrf54l15_npm2100/nrf54l15/cpuapp
              - seeed_nrf54l15_npm2100/nrf54l15/cpuapp/ns
              - seeed_nrf54l15_npm2100/nrf54l15/cpuflpr
              - seeed_nrf54l15_npm2100/nrf54l15/cpuflpr/xip
```
